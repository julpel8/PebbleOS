## src/fw/Kconfig
```kconfig
# SPDX-FileCopyrightText: 2026 Core Devices LLC
# SPDX-License-Identifier: Apache-2.0

rsource "apps/Kconfig"
rsource "drivers/Kconfig"
rsource "kernel/Kconfig"
rsource "services/Kconfig"

menu "Software Features"

config SETTINGS_ICONS
    bool "Settings menu icons"
    help
      Show icons next to entries in the system Settings menu.

config THEMING
    bool "Color theming"
    help
      Expose the highlight-color theming UI under Settings.

config DYNAMIC_BACKLIGHT
    bool "Dynamic backlight"
    help
      Adjust backlight intensity based on ambient light readings.
      Requires an ambient light sensor.

config ACCEL_SENSITIVITY
    bool "Accelerometer sensitivity setting"
    help
      Expose the accelerometer tap/shake sensitivity adjustment in
      Settings.

config APP_SCALING
    bool "App scaling"
    help
      Scale legacy lower-resolution apps to the current display via
      the compositor.

config ORIENTATION_MANAGER
    bool "Orientation manager UI"
    help
      Expose the device-orientation / rotation prefs in shell and
      Settings. Independent of CONFIG_SERVICE_ORIENTATION_MANAGER,
      which controls whether the underlying service is built.

config MODDABLE_XS
    bool "Moddable XS JavaScript engine"
    help
      Build Moddable XS support for running JavaScript apps. PRF
      variant builds force this off regardless of the board default.

config MMAP_RESOURCES
    bool "Memory-mapped (zero-copy) resource reads"
    help
      Serve read-only system resources as direct pointers into
      memory-mapped flash instead of copying them out.

endmenu

choice
    prompt "Shell"
    default SHELL_NORMAL

config SHELL_NORMAL
    bool "Normal shell"

config SHELL_SDK
    bool "SDK shell"
    help
      Use the SDK shell instead of the normal shell.

config SHELL_HTOP
    bool "Htop shell"
    select WATCHFACE_BUTTONS
    help
      Minimal shell that boots straight into the htop watchface. No
      launcher, no third-party apps, no settings.

endchoice

config WATCHFACE_BUTTONS
    bool "Give button events to the running watchface"
    help
      The shell normally keeps the buttons for itself while a watchface
      runs, for the launcher and quick launch. A shell with no UI of its
      own has nothing to do with them, so hand them to the watchface.

menu "Debug & instrumentation"

config NO_WATCH_TIMEOUT
    bool "Disable watchface idle timeout"

config NO_WATCHDOG
    bool "Disable watchdog reboots"
    help
      Do not reboot automatically when a watchdog fires; break into
      the debugger instead.

config UI_DEBUG
    bool "UI debug commands"
    help
      Enable the window dump and layer nudge CLI commands.

config PROMPT
    bool "Serial console prompt"
    default y
    help
      Build the serial console. Disable to save space.

config MALLOC_INSTRUMENTATION
    bool "Malloc instrumentation"
    help
      Track the caller PC of every heap allocation.

config PROFILER
    bool "Profiler"

config PROFILE_INTERRUPTS
    bool "Profile all interrupts"
    select PROFILER

config PERFORMANCE_TESTS
    bool "Performance test instrumentation"
    select PROFILER

endmenu
```

## subsys/logging/Kconfig
```kconfig
# SPDX-FileCopyrightText: 2026 Core Devices LLC
# SPDX-License-Identifier: Apache-2.0

menu "Logging"

config LOG
    bool "Logging"
    default y
    help
      Build the PBL_LOG macros. Disable to save space.

config LOG_HASHED
    bool "Hashed logs"
    default y
    depends on LOG && !QEMU
    help
      Replace log format strings with hashes to save space. Disable
      for human-readable logs.

choice
    prompt "Default log level"
    default DEFAULT_LOG_LEVEL_INFO

config DEFAULT_LOG_LEVEL_ERROR
    bool "Error"

config DEFAULT_LOG_LEVEL_WARNING
    bool "Warning"

config DEFAULT_LOG_LEVEL_INFO
    bool "Info"

config DEFAULT_LOG_LEVEL_DEBUG
    bool "Debug"

config DEFAULT_LOG_LEVEL_DEBUG_VERBOSE
    bool "Debug verbose"

endchoice

choice
    prompt "Flash log level"
    default FLASH_LOG_LEVEL_INFO

config FLASH_LOG_LEVEL_ERROR
    bool "Error"

config FLASH_LOG_LEVEL_WARNING
    bool "Warning"

config FLASH_LOG_LEVEL_INFO
    bool "Info"

config FLASH_LOG_LEVEL_DEBUG
    bool "Debug"

config FLASH_LOG_LEVEL_DEBUG_VERBOSE
    bool "Debug verbose"

endchoice

config LOG_TASK_PREFIX
    bool "Task prefix"
    depends on LOG
    help
      Prefix log messages with the originating task identifier char
      (uppercase when logged from privileged mode).

config DBGSERIAL_RX
    bool "Debug serial receiver"
    default y if !RELEASE || MFG
    help
      Keep the receiver of the debug UART enabled, for the console and
      PULSE. On SF32LB52 an enabled receiver holds the SoC out of its
      deepest low power modes, so a build that only needs the outgoing
      log stream should turn it off.

config PULSE_EVERYWHERE
    bool "PULSE everywhere"
    depends on DBGSERIAL_RX
    default y if !RELEASE || MFG
    help
      Use the PULSE protocol for logs and the prompt. Disable to fall
      back to legacy logs and prompt.

endmenu
```
